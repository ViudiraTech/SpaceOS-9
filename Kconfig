## Kconfig
```kconfig
#
#       Kconfig
#       Kernel configuration menu
#
#       2026/9/30 By JiTianYu391
#       Copyright (C) 2026 ViudiraTech.
#

mainmenu "SpaceKernel configuration"

menu "Platform"

choice
	prompt "Target architecture"
	default ARCH_X86_64

config ARCH_X86_64
	bool "x86_64"

config ARCH_AARCH64
	bool "AArch64"

config ARCH_RISCV64
	bool "RISC-V 64"
endchoice

config SMP
	bool "Symmetric multiprocessing support"
	default y
	help
	  Multi-core boot, per-CPU scheduling queues and inter-processor
	  interrupts.

config MAX_CPUS
	int "Maximum number of CPUs"
	depends on SMP
	range 1 256
	default 64

config RISCV_SV48
	bool "Sv48 paging"
	depends on ARCH_RISCV64
	help
	  Use four-level paging on CPUs that support it. Sv39 is the default.

endmenu

menu "General setup"

choice
	prompt "Build profile"
	default PROFILE_DEBUG

config PROFILE_DEBUG
	bool "Debug"

config PROFILE_RELEASE
	bool "Release"
endchoice

config KASLR
	bool "Randomize kernel address layout (KASLR)"
	default y
	help
	  Ask Limine to randomize the kernel and direct-map base addresses.

config KERNEL_CMDLINE
	string "Kernel command line"
	default "console=tty0 console=ttyS0"
	help
	  Console selection passed to the kernel by the bootloader. Repeat
	  console= to enable more than one output.

config KALLSYMS
	bool "Kernel symbol table"
	default y
	help
	  Expose kernel symbols through /proc/kallsyms.

config KALLSYMS_ALL
	bool "Include data symbols in the symbol table"
	depends on KALLSYMS
	help
	  Also emit data, BSS and read-only symbols. Without this, only
	  functions are listed.

endmenu

menu "Device drivers"

menuconfig PS2
	bool "PS/2 controller"
	default y
	help
	  i8042 controller and PS/2 input devices.

if PS2

config PS2_KEYBOARD
	bool "PS/2 keyboard"
	default y

config PS2_MOUSE
	bool "PS/2 mouse"
	default y

endif # PS2

config SERIAL
	bool "Serial console"
	default y
	help
	  16550-compatible UART and PL011 console output.

config TTY
	bool "Virtual terminals"
	default y
	help
	  TTY line discipline, canonical input and virtual consoles.

config FRAMEBUFFER
	bool "Framebuffer console"
	default y
	help
	  Graphical console on the Limine framebuffer.

config PCI
	bool "PCI support"
	default y
	help
	  PCI and PCIe ECAM configuration space access.

menuconfig BLOCK
	bool "Block device support"
	default y
	help
	  Block layer, sector cache and MBR/GPT partition parsing.

if BLOCK

menu "Storage controllers"
	depends on PCI

config IDE
	bool "IDE/PATA support"
	default y
	help
	  PCI IDE controllers with bus-master DMA and LBA28/48 PIO.

config AHCI
	bool "AHCI SATA support"
	default y
	help
	  AHCI 1.0 controllers with command lists and PRDT DMA.

config NVME
	bool "NVMe support"
	default y
	help
	  PCIe NVMe controllers with admin and I/O queue pairs.

endmenu

endif # BLOCK

menu "Sound"

menuconfig SOUND
	bool "ALSA-compatible sound support"
	default y
	help
	  Linux ALSA ABI compatible sound core: /dev/snd character devices,
	  PCM playback/capture, the mixer control interface and the timer
	  device.  Unmodified alsa-lib and tinyalsa programs can use it.

if SOUND

config SOUND_DUMMY
	bool "Dummy sound card"
	default y
	help
	  Built-in full-duplex software card used by the boot self-test.  It
	  is also the reference implementation for loadable drivers.

endif # SOUND

endmenu

menu "File systems"

config VFS
	bool "Virtual file system"
	default y
	help
	  Linux ABI VFS, file descriptor tables, pipes, RamFS, DevFS and
	  ProcFS.

if VFS

config FAT32
	bool "FAT32 (VFAT) support"
	depends on BLOCK
	default y
	help
	  FAT32 read/write with VFAT long file names.

endif # VFS

endmenu

menu "Kernel features"

config EEVDF_SCHED
	bool "EEVDF scheduler"
	default y
	help
	  Earliest Eligible Virtual Deadline First scheduling per CPU.

config USER_SPACE
	bool "User space support"
	default y
	help
	  Isolated address spaces, privilege transitions, ELF loading and
	  Linux ABI system calls.

config KSHELL
	bool "Kernel shell"
	default y
	help
	  Interactive diagnostic shell on the serial and foreground
	  consoles.

endmenu

menu "Module support"

menuconfig MODULES
	bool "Loadable kernel modules"
	default y
	help
	  init_module(2), finit_module(2) and delete_module(2) for ET_REL
	  modules built against the exported symbol ABI.

if MODULES

config MODULE_UNLOAD
	bool "Module unloading"
	default y
	help
	  Allow delete_module(2) to run a module's exit routine.

config MODULE_FORCE_UNLOAD
	bool "Forced module unloading (DANGEROUS)"
	depends on MODULE_UNLOAD
	help
	  Allow unloading a module with a non-zero reference count. The
	  caller must ensure that no CPU is executing module code.

menu "Modules to build"

menu "Network drivers"

config MODULE_E1000
	bool "Intel PRO/1000 gigabit Ethernet"
	depends on PCI
	default y
	help
	  Build e1000.ko for 8254x-based adapters.

config MODULE_E1000E
	bool "Intel PRO/1000e PCIe gigabit Ethernet"
	depends on PCI
	default y
	help
	  Build e1000e.ko for 82574L and related PCIe adapters.

endmenu

menu "Sample modules"

config MODULE_HELLO
	bool "C hello module"
	default y
	help
	  Build hello.ko, the C sample used by the boot self-test.

config MODULE_HELLO_RUST
	bool "Rust hello module"
	default y
	help
	  Build hello-rust.ko, the Rust sample used by the boot self-test.

endmenu

endmenu

endif # MODULES

endmenu

menu "Testing"

config BOOT_SELF_TEST
	bool "Boot self-tests"
	help
	  Run CPU, memory, SMP, scheduler and user-space smoke tests at
	  boot.

config QEMU_CPUS
	int "QEMU CPUs"
	range 1 64
	default 4

config QEMU_MEMORY_MIB
	int "QEMU memory (MiB)"
	range 128 8192
	default 512

endmenu
```
